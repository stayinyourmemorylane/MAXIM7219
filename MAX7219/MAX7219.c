/*
 * MAX7219.c
 *
 * Created: 2/7/2013 9:31:01 PM
 *  Author: Michael
 */ 

#include "max7219.h"
#include <avr/io.h>

char array[] = {
	0x00, 0x00, 0x00, 0x00, 0x00, //  space
	0x00, 0x00, 0xFD, 0x00, 0x00, //  !
	0x00, 0x00, 0x00, 0x00, 0x00, //   " not done
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	0x11, 0x13, 0x15, 0x19, 0x11 //  z
};


void writechar(int xcorridnate, char c){
	
		if (xcorridnate >= 0 && xcorridnate <= 3){
		
			for (int x=0; x< 5; x++)
			{
				Send_Max7219((xcorridnate+(x+1)),array[((c-32)*5) + x]);
			}
			Send_Max7219((xcorridnate), 0x00);
			Send_Max7219((xcorridnate+6), 0x00);
		}
		
		
		/// Draw the negative portion of the character
		/// Draw partial char   END<---- 
		if (xcorridnate < 0 && xcorridnate >=-5){
			for (int x=0; x < 5 + xcorridnate; x++)
			{
				Send_Max7219((x+1),array[((c-32)*5) + (x-xcorridnate)]);
			}
			Send_Max7219((xcorridnate+6), 0x00); // only necessary to add space to the right of partial-char
		}

		
		/// Draw the Positive portion of the character
		/// Draw partial char  <---- Start
		if (xcorridnate > 4 && xcorridnate <= 8){
			for (int x=0; x < 9-xcorridnate; x++)
			{
				Send_Max7219((xcorridnate+x),array[((c-32)*5) + (x)]);
			}
		 	Send_Max7219((xcorridnate-1), 0x00); // only necessary to add space to the left of partial-char
		}
		
		
 return 0; 
}

char array2[] = {0xFF};
void writestring(int xcorridnate, char *string){
	while (*string)
	{
		writechar(xcorridnate,*string);
		string++;
		_delay_ms(1000);
	}
}

void writestring_scroll(int xcorridnate, char *string){
	int count=0; 
	while (*string)
	{
		string++;
		count++;
	}
	for (int x=8; x >= (count*(-7)); x--){
	//	writechar()
		
	}	
	
}

void clear_screen(void){
	for (int x=0; x < 8; x++)Send_Max7219(x, 0x00);
}


int main(void)
{
	SPI_MasterInit();  
    Initilize_Max7219();
	clear_screen();

	while (1){ 
			/* for(int x=8; x >= -40; x-- )
			 {
				 writechar(x, 'T');
				 writechar(x+7, 'E');
				 writechar(x+14, 'S');
				 writechar(x+21, 'T');
				 writechar(x+28, '!');
				 writechar(x+35, '!');
				 _delay_ms(1000);
			 }
			 */
			    //   Send_Max7219((1),0x00);
			
				
			for (int x=1; x < 4; x++){
				Send_Max7219((x), 0xFF);
				Send_Max7219((x+1), 0xFF);
				_delay_ms(9000);
				Send_Max7219((x),0x00);
				Send_Max7219((x+1), 0x00);
				}				    
			}	
}
		


		/*

		for(int x=12; x >= -12; x-- )
		{
			writechar(x, 'T');
			_delay_ms(1000);
		}

		 for (int y= 0; y < 90; y++ )
		 {
			 for (int x=0; x< 5; x++)
			 {
				 Send_Max7219((x+1),array[((5*y)+x)]);
			 }
			 Send_Max7219(0x06, 0x00);
			 Send_Max7219(0x07, 0x00);
			 Send_Max7219(0x08, 0x00);
			 _delay_ms(10000);
		 }
		
		
		for (int x=0; x<8; x++ )
		{
			for (int y=1; y< 9; y++)
			{
				Send_Max7219((y),array2[x]);
				_delay_ms(1000);
			}
		}
		
		
	*/